## boards/custom/crsf_fsdb01/Kconfig.crsf_fsdb01
```kconfig
# SPDX-License-Identifier: Apache-2.0

config BOARD_CRSF_FSDB01
	select SOC_STM32G0B1XX
```

## boards/custom/crsf_fsdb01/board.yml
```yaml
board:
  name: crsf_fsdb01
  full_name: CRSF to FSDB01 (STM32G0B1CET6)
  vendor: custom
  socs:
    - name: stm32g0b1xx
```

## boards/custom/crsf_fsdb01/crsf_fsdb01_defconfig
```kconfig
# Enable MPU
CONFIG_ARM_MPU=y

# Serial Drivers
CONFIG_SERIAL=y
CONFIG_UART_INTERRUPT_DRIVEN=y

# GPIO Controller
CONFIG_GPIO=y
```

## drivers/fsdb01/Kconfig
```kconfig
# SPDX-License-Identifier: Apache-2.0

menuconfig FSDB01
	bool "FlySky FS-DB01 LED module driver"
	default y
	depends on DT_HAS_FLYSKY_FSDB01_ENABLED
	select GPIO
	help
	  Driver for the FlySky FS-DB01 LED control module's single-wire
	  protocol.

if FSDB01

config FSDB01_INIT_PRIORITY
	int "Init priority"
	default KERNEL_INIT_PRIORITY_DEVICE
	help
	  Device init priority. Must be after the GPIO driver.

module = FSDB01
module-str = fsdb01
source "subsys/logging/Kconfig.template.log_config"

endif # FSDB01
```
